# file: test_writer.ioc
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Mcu.Family=STM32F0
Mcu.Name=STM32F051R8Tx
Mcu.Package=LQFP64
PA13.Mode=Serial_Wire
PA13.Signal=SYS_SWDIO
PA14.Mode=Serial_Wire
PA14.Signal=SYS_SWCLK
PA9.Mode=Half_duplex(single_wire_mode)
PA9.Signal=USART1_TX
ProjectManager.HeapSize=0x200
ProjectManager.StackSize=0x400
ProjectManager.TargetToolchain=MDK-ARM V5.32
USART1.BaudRate=9600
USART1.VirtualMode-Half_duplex(single_wire_mode)=VM_ASYNC
board=custom

// file: Core/Src/main.c
/* USER CODE BEGIN Header */
/**
  ******************************************************************************
  * @file           : main.c
  * @brief          : Main program body
  ******************************************************************************
  * @attention
  *
  * Copyright (c) 2023 STMicroelectronics.
  * All rights reserved.
  *
  * This software is licensed under terms that can be found in the LICENSE file
  * in the root directory of this software component.
  * If no LICENSE file comes with this software, it is provided AS-IS.
  *
  ******************************************************************************
  */
/* USER CODE END Header */
#include "main.h"

/* USER CODE BEGIN Includes */
#include "fw.h"
/* USER CODE END Includes */

UART_HandleTypeDef huart1;

void SystemClock_Config(void);
static void MX_GPIO_Init(void);
static void MX_USART1_UART_Init(void);

/* USER CODE BEGIN 0 */
#define UART USART1
static void SendData(const uint8_t* data, uint32_t size)
{
	// enable Tx

	UART->CR1 = USART_CR1_TE | USART_CR1_UE;
	while (size--)
	{
		UART->TDR = *(data++);
		while(!(UART->ISR & USART_ISR_TXE_Msk));
	}

	while(!(UART->ISR & USART_ISR_TC_Msk));

	UART->CR1 = USART_CR1_UE;
}

static uint16_t ReceiveData(uint8_t *data)
{
	UART->CR1 = USART_CR1_RE | USART_CR1_UE;
	while(!(UART->ISR & USART_ISR_RXNE_Msk));
	*data = UART->RDR;

	uint16_t size = *data;
	data++;
	size += 3;	// sizeByte typeByte .. CheckSummByte

	for(int i=1; i<size; i++)
	{
		while(!(UART->ISR & USART_ISR_RXNE_Msk));
		*(data++) = UART->RDR;
	}

	UART->CR1 = USART_CR1_UE;
	return size;
}

uint8_t buff[0x400];
uint8_t page_size_pow;
uint16_t page_max;
/* USER CODE END 0 */

int main(void)
{

  /* MCU Configuration--------------------------------------------------------*/

  /* Reset of all peripherals, Initializes the Flash interface and the Systick. */
  HAL_Init();

  /* Configure the system clock */
  SystemClock_Config();

  /* Initialize all configured peripherals */
  MX_GPIO_Init();
  MX_USART1_UART_Init();
  /* USER CODE BEGIN 2 */

	uint16_t size = ReceiveData(buff);
	page_size_pow = buff[5];
	uint16_t page_size = 1<<page_size_pow;
	page_max = (buff[6]<<8) + buff[7];
	uint8_t xor;
	uint16_t current_page = 0;
	uint8_t *fw_arr_p = (uint8_t*)fw_arr;
	while (current_page * page_size < sizeof(fw_arr))
	{
		xor = 0;
		buff[0] = 0xFF;
		buff[1] = 0x88;
		buff[2] = current_page>>8;
		buff[3] = current_page;

		for (int i=0; i<page_size; i++)
			buff[4+i] = *fw_arr_p++;
		for (int k=0; k<(1<<page_size_pow)+4; k++)
			xor ^= buff[k];
		buff[(1<<page_size_pow)+4] = xor;
		SendData(buff, (1<<page_size_pow) + 5);
		size = ReceiveData(buff);
		current_page++;
	}

	buff[0] = 0;
	buff[1] = 0xC7;
	buff[2] = 0xC7;
	SendData(buff, 3);
  /* USER CODE END 2 */
  /* Infinite loop */
  while (1)
  {

  }
}

void SystemClock_Config(void)
{
  RCC_OscInitTypeDef RCC_OscInitStruct = {0};
  RCC_ClkInitTypeDef RCC_ClkInitStruct = {0};
  RCC_PeriphCLKInitTypeDef PeriphClkInit = {0};

  /** Initializes the RCC Oscillators according to the specified parameters
  * in the RCC_OscInitTypeDef structure.
  */
  RCC_OscInitStruct.OscillatorType = RCC_OSCILLATORTYPE_HSI;
  RCC_OscInitStruct.HSIState = RCC_HSI_ON;
  RCC_OscInitStruct.HSICalibrationValue = RCC_HSICALIBRATION_DEFAULT;
  RCC_OscInitStruct.PLL.PLLState = RCC_PLL_NONE;
  if (HAL_RCC_OscConfig(&RCC_OscInitStruct) != HAL_OK)
  {
    Error_Handler();
  }

  /** Initializes the CPU, AHB and APB buses clocks
  */
  RCC_ClkInitStruct.ClockType = RCC_CLOCKTYPE_HCLK|RCC_CLOCKTYPE_SYSCLK
                              |RCC_CLOCKTYPE_PCLK1;
  RCC_ClkInitStruct.SYSCLKSource = RCC_SYSCLKSOURCE_HSI;
  RCC_ClkInitStruct.AHBCLKDivider = RCC_SYSCLK_DIV1;
  RCC_ClkInitStruct.APB1CLKDivider = RCC_HCLK_DIV1;

  if (HAL_RCC_ClockConfig(&RCC_ClkInitStruct, FLASH_LATENCY_0) != HAL_OK)
  {
    Error_Handler();
  }
  PeriphClkInit.PeriphClockSelection = RCC_PERIPHCLK_USART1;
  PeriphClkInit.Usart1ClockSelection = RCC_USART1CLKSOURCE_PCLK1;
  if (HAL_RCCEx_PeriphCLKConfig(&PeriphClkInit) != HAL_OK)
  {
    Error_Handler();
  }
}

static void MX_USART1_UART_Init(void)
{

  huart1.Instance = USART1;
  huart1.Init.BaudRate = 9600;
  huart1.Init.WordLength = UART_WORDLENGTH_8B;
  huart1.Init.StopBits = UART_STOPBITS_1;
  huart1.Init.Parity = UART_PARITY_NONE;
  huart1.Init.Mode = UART_MODE_TX_RX;
  huart1.Init.HwFlowCtl = UART_HWCONTROL_NONE;
  huart1.Init.OverSampling = UART_OVERSAMPLING_16;
  huart1.Init.OneBitSampling = UART_ONE_BIT_SAMPLE_DISABLE;
  huart1.AdvancedInit.AdvFeatureInit = UART_ADVFEATURE_NO_INIT;
  if (HAL_HalfDuplex_Init(&huart1) != HAL_OK)
  {
    Error_Handler();
  }

}

static void MX_GPIO_Init(void)
{

  /* GPIO Ports Clock Enable */
  __HAL_RCC_GPIOA_CLK_ENABLE();

}

void Error_Handler(void)
{
  __disable_irq();
  while (1)
  {
  }
}
